## lnet/Kconfig
```kconfig
# SPDX-License-Identifier: GPL-2.0-only
config LIBCFS
	tristate
	help
	  libcfs is a foundational library shared by Lustre and LNet. It
	  provides the debug and tracing infrastructure.

	  LIBCFS is required by LNet and Lustre and is selected
	  automatically whenever either is enabled. It has no prompt of
	  its own.

config LNET
	tristate "Lustre networking subsystem (LNet)"
	depends on INET
	select LIBCFS
	help
	  The Lustre network layer, also known as LNet, is a networking abstraction
	  level API that was initially created to allow Lustre Filesystem to utilize
	  very different networks like tcp and ib verbs in a uniform way. In the
	  case of Lustre routers only the LNet layer is required. Lately other
	  projects are also looking into using LNet as their networking API as well.

config LNET_DUMP_ON_PANIC
	bool "LNet dump logs on panic"
	depends on LNET
	help
	  Special functionality to enable collecting extra logs when LNet panics.
	  Normally only used by developers for debugging purposes.

	  If unsure, say N.

config LUSTRE_DEBUG_EXPENSIVE_CHECK
	bool "Enable Lustre DEBUG checks"
	depends on LNET
	help
	  This option is mainly for debug purpose. It enables libcfs, LNet
	  and Lustre code to do expensive checks that may have a performance
	  impact.

	  Use with caution. If unsure, say N.

config LNET_SELFTEST
	tristate "Lustre networking self testing"
	depends on LNET
	help
	  Choose Y here if you want to do lnet self testing. To compile this
	  as a module, choose M here: the module will be called lnet_selftest.

	  If unsure, say N.

	  See also http://wiki.lustre.org/

source "net/lnet/klnds/socklnd/Kconfig"
```

## lnet/klnds/efalnd/Kconfig
```kconfig
# SPDX-License-Identifier: GPL-2.0-only
config LNET_EFALND
	tristate "AWS EFA LND (kefalnd)"
	depends on LNET && INFINIBAND && INFINIBAND_EFA
	default n
	help
	  The efa LND (kefalnd) carries LNet traffic over the AWS Elastic
	  Fabric Adapter using the EFA verbs provider.

	  To compile this as a kernel module, choose M here and it will be
	  called kefalnd.

	  If unsure, say N.
```

## lnet/klnds/gnilnd/Kconfig
```kconfig
# SPDX-License-Identifier: GPL-2.0-only
config LNET_GNILND
	tristate "Cray GNI LND (kgnilnd)"
	depends on LNET
	default n
	help
	  The gni LND (kgnilnd) carries LNet traffic over the Cray Gemini
	  and Aries high-speed networks using the GNI API. It requires the
	  Cray GNI kernel headers, so it is normally only built on Cray
	  systems.

	  To compile this as a kernel module, choose M here and it will be
	  called kgnilnd.

	  If unsure, say N.
```

## lnet/klnds/kfilnd/Kconfig
```kconfig
# SPDX-License-Identifier: GPL-2.0-only
config LNET_KFILND
	tristate "Kfabric LND (kkfilnd)"
	depends on LNET
	default n
	help
	  The kfi LND (kkfilnd) carries LNet traffic over kfabric (kernel
	  libfabric) providers, such as the Cray Slingshot CXI network. It
	  requires the out-of-tree kfabric kernel headers.

	  To compile this as a kernel module, choose M here and it will be
	  called kkfilnd.

	  If unsure, say N.
```

## lnet/klnds/o2iblnd/Kconfig
```kconfig
# SPDX-License-Identifier: GPL-2.0-only
config LNET_XPRT_IB
	tristate "OpenFabrics InfiniBand LND (ko2iblnd)"
	depends on LNET && PCI && INFINIBAND && INFINIBAND_ADDR_TRANS
	default n
	help
	  The o2ib LND (ko2iblnd) carries LNet traffic over OpenFabrics
	  InfiniBand and RoCE fabrics using the RDMA verbs API.

	  To compile this as a kernel module, choose M here and it will be
	  called ko2iblnd.

	  If unsure, say N.
```

## lnet/klnds/socklnd/Kconfig
```kconfig
# SPDX-License-Identifier: GPL-2.0-only
config LNET_SOCKLND
	tristate "TCP/IP socket LND (ksocklnd)"
	depends on LNET
	default LNET
	help
	  The socket LND (ksocklnd) carries LNet traffic over any
	  TCP/IP-capable network interface. It is the default LNet network
	  driver and requires no special hardware.

	  To compile this as a kernel module, choose M here and it will be
	  called ksocklnd.

	  If unsure, say Y.
```

## lustre/Kconfig
```kconfig
# SPDX-License-Identifier: GPL-2.0-only
config LUSTRE_FS
	tristate "Lustre file system client support"
	depends on LNET
	select LUSTRE_FS_COMMON
	select CRYPTO
	select CRYPTO_MD5
	select CRYPTO_SHA1
	select CRYPTO_SHA256
	select CRYPTO_SHA512
	select CRC_T10DIF
	select DEBUG_FS
	select FHANDLE
	select QUOTA
	depends on MULTIUSER
	help
	  This option enables Lustre file system client support. Choose Y
	  here if you want to access a Lustre file system cluster. To compile
	  this file system support as a module, choose M here: the module will
	  be called lustre.

	  To mount Lustre file systems, you also need to install the user space
	  mount.lustre and other user space commands which can be found in the
	  lustre-client package, available from
	  http://downloads.whamcloud.com/public/lustre/

	  Lustre file system is the most popular cluster file system in high
	  performance computing. Source code of both kernel space and user space
	  Lustre components can also be found at:
	  https://github.com/lustre/lustre-release

	  If unsure, say N.

	  See also http://wiki.lustre.org/

config LUSTRE_FS_SERVER
	tristate "Lustre file system server support"
	depends on LNET
	select LUSTRE_FS_COMMON
	help
	  Enable Lustre server support (MDS, OSS, MGS).

	  If unsure, say N.

source "fs/lustre/osd-wbcfs/Kconfig"

config LUSTRE_FS_COMMON
	tristate
	depends on LNET
	help
	  Internal symbol covering the modules shared by the Lustre client
	  and server (obdclass, ptlrpc, ldlm, fid, mgc, obdecho, ec). It is
	  selected automatically whenever Lustre is enabled and has no prompt
	  of its own.

config LUSTRE_FS_GSS
	tristate "Lustre GSS support"
	depends on LUSTRE_FS
	select SUNRPC
	default n
	help
	  Enable GSS (Generic Security Services) support for Lustre,
	  providing Kerberos authentication and encryption.

	  If unsure, say N.

config LUSTRE_FS_GSS_SSK
	bool "Lustre GSS shared-secret key support"
	default n
	depends on LUSTRE_FS_GSS
	help
	  Enable shared-secret key (SSK) mechanism for Lustre GSS.

	  If unsure, say N.

config LUSTRE_FS_GSS_KEYRING
	bool "Lustre GSS keyring support"
	default n
	depends on LUSTRE_FS_GSS
	depends on KEYS
	help
	  Enable kernel keyring integration for Lustre GSS.

	  If unsure, say N.

config LUSTRE_FS_POSIX_ACL
	bool "Lustre POSIX Access Control Lists"
	depends on LUSTRE_FS_COMMON
	select FS_POSIX_ACL
	default y
	help
	  POSIX Access Control Lists (ACLs) support permissions for users and
	  groups beyond the owner/group/world scheme.
	  Lustre can support these ACLs.

	  If in doubt, say Y.

config LUSTRE_FS_PINGER
	bool "Enable Lustre pinger"
	depends on LUSTRE_FS_COMMON
	default y
	help
	  Lustre creates a pinger to determine if nodes are available. Newer
	  versions of lustre allow disabling this feature.

	  If in doubt, say Y.

config LUSTRE_FS_TESTS
	tristate "Lustre kernel unit tests"
	depends on LUSTRE_FS
	default n
	help
	  Build the Lustre in-kernel unit test modules.

	  If unsure, say N.
```

## lustre/osd-ldiskfs/Kconfig
```kconfig
# SPDX-License-Identifier: GPL-2.0-only
config LUSTRE_FS_LDISKFS
	tristate "Lustre ldiskfs OSD support"
	default n
	depends on LUSTRE_FS_SERVER
	depends on EXT4_FS
	help
	  Enable the ldiskfs (ext4-based) Object Storage Device backend
	  for Lustre servers.

	  If unsure, say N.
```

## lustre/osd-wbcfs/Kconfig
```kconfig
# SPDX-License-Identifier: GPL-2.0-only
config LUSTRE_FS_WBCFS
	tristate "Lustre wbcfs OSD support"
	default n
	depends on LUSTRE_FS_SERVER
	help
	  Enable the wbcfs (in-memory writeback cache) Object Storage Device
	  backend for Lustre servers.

	  If unsure, say N.
```
